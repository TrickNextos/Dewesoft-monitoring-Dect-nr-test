## CMakeLists.txt
```
#
# Copyright (c) 2024 Nordic Semiconductor
#
# SPDX-License-Identifier: LicenseRef-Nordic-5-Clause
#

cmake_minimum_required(VERSION 3.20.0)

find_package(Zephyr REQUIRED HINTS $ENV{ZEPHYR_BASE})
project(hello_dect)

target_sources(app PRIVATE src/common.c)
target_sources(app PRIVATE src/transmit.c)
target_sources(app PRIVATE src/recieve.c)
target_sources(app PRIVATE src/serial_communication.c)
target_sources(app PRIVATE src/init.c)
target_sources(app PRIVATE src/main.c)
```

## Kconfig
```
#
# Copyright (c) 2024 Nordic Semiconductor
#
# SPDX-License-Identifier: LicenseRef-Nordic-5-Clause
#

config CARRIER
	int "Carrier to use"
	default 0
	help
	   The availability of the channels and the exact regulation to use them varies in different countries.
	   See ETSI TS 103 636-2 5.4.2 for the calculation.

config NETWORK_ID
	int "Network ID"
	range 1 4294967295
	default 91

config MCS
	int "MCS"
	default 1
	help
	   The MCS impacts how much data can fit into each subslot.

config TX_POWER
	int "TX power"
	range 0 13
	default 13
	help
	   Transmission power, max 19 dBm due to hardware limitations.
	   See table 6.2.1-3 of ETSI TS 103 636-4 v1.5.1.

config TX_TRANSMISSIONS
	int "TX transmissions"
	range 0 4294967295
	default 30
	help
	   Transmissions before sample exits, use 0 to transmit forever.

config RX_PERIOD_MS
	int "RX period"
	default 5
	help
	   Receive window period.
	   Time is given in seconds.

module = DECT_PHY_HELLO
module-str = DECT NR+ PHY Hello
source "${ZEPHYR_BASE}/subsys/logging/Kconfig.template.log_config"

menu "Zephyr Kernel"
source "Kconfig.zephyr"
endmenu
```

## prj.conf
```kconfig
CONFIG_NRF_MODEM_LIB=y

CONFIG_MODEM_ANTENNA=n

CONFIG_NRF_MODEM_LINK_BINARY_DECT_PHY=y
CONFIG_HWINFO=y

CONFIG_LOG=y

CONFIG_GPIO=y

CONFIG_REBOOT=y

CONFIG_SERIAL=y
CONFIG_UART_ASYNC_API=y
```

## src/main.c
```c
/*
 * Copyright (c) 2024 Nordic Semiconductor ASA
 *
 * SPDX-License-Identifier: LicenseRef-Nordic-5-Clause
 */

#include "main.h"
#include "init.h"
#include "common.h"

#include "transmit.h"
#include "recieve.h"

#include "serial_communication.h"

LOG_MODULE_REGISTER(main);

// static Globals globals = {};

// if this is the error, include overlay-eu.proj/overlay-us.proj into build
BUILD_ASSERT(CONFIG_CARRIER, "Carrier must be configured according to local regulations");

static bool exit;
// static uint16_t device_id;

// char tx_buf[MAX_DATA_LEN] = "Eos harum dolorum in iure aspernatur aut consectetur dolores. In quae itaque et dolorem natus quo voluptate molestias non commodi officia est laborum molestiae est vitae aliquam. Non autem ipsa ex consequuntur quae et natus tempore! Sed debitis pariatur non optio inventore sit aspernatur mollitia ut ipsa sunt a impedit nihil eum asperiores possimus est ullam quis. 33 architecto expedita eos autem quisquam ea sapiente saepe et delectus facilis et odio excepturi ad numquam iure. Aut sunt quia in nihil architecto cum explicabo sint et galisum perspiciatis. Non possimus mollitia non Quis labore eos dignissimos galisum. Qui excepturi accusamus eum tempora quibusdam et deserunt omnis qui consequuntur pariatur sit dignissimos vero est nisi distinctio est quaerat doloremque.Aut galisum vero id rerum molestiae sed dolores nihil. Ex dolor quia ut provident modi qui voluptatem iusto vel quia explicabo ut expedita quam sed quia reprehenderit aut repellat perspiciatis. Et delectus aliquid quo aspernatur quidem sit reiciendis sint. Ut molestiae consequatur ea eaque consequatur et fugiat consequatur vel suscipit dolores ad nesciunt dolorem. Non quibusdam maiores et blanditiis laborum sed vitae nemo et distinctio sunt aut dolor repudiandae. Non praesentium rerum aut voluptas error vel eius pariatur aut reprehenderit voluptatum? Et vero nemo ad amet enim et vitae veniam in optio consequatur non autem itaque eos animi expedita. Sit quis suscipit cum ipsum enim rem omnis nobis eum debitis autem. Aut similique voluptatem non recusandae quod ad reprehenderit blanditiis eos voluptate nostrum. Et distinctio doloremque non molestiae doloribus ut placeat accusamus et magnam doloremque At aliquid quia. Est quam sint non assumenda dolorem hic rerum facilis a reprehenderit voluptatibus in assumenda commodi ut provident corporis et numquam recusandae. Et dolorem architecto et deleniti autem vel Quis earum. Ut nisi maxime id beatae nostrum id magnam accusantium ad nesciunt libero! 33 incidunt rerum eum voluptatem esse qui iure odit et cupiditate sunt.Sit rerum necessitatibus rem eveniet repellat ut error sunt rem sunt tempora eum cupiditate amet non consectetur tempore. Ut amet accusantium rem sequi molestias sed inventore ipsa in ipsa voluptatem. In aliquam corrupti et ducimus dolores rem voluptatem repellat aut odit temporibus et soluta maxime. Et recusandae quia in porro laborum aut culpa tenetur. Ut tempora expedita a quia eveniet et galisum culpa et nisi fugit. Non aliquid saepe eos sequi eaque rem maiores saepe hic porro omnis ea voluptas dolores sit deserunt similique non illum rerum. Non nostrum veniam et impedit nisi vel dolor eveniet ab blanditiis nesciunt non eveniet numquam. In quos omnis non obcaecati voluptatum ea unde earum qui dolor adipisci et odio dolor! Ut galisum totam ut sint porro ab illum dolore et dolorem nostrum. Et numquam culpa aut enim labore ut quis rerum qui autem fugit a harum sapiente. Cum repellat nisi hic impedit autem aut quis similique. Et molestiae doloremque non voluptatem tenetur est quisquam totam eum fuga temporibus cum laborum obcaecati sed eveniet doloribus a voluptatibus labore. In deserunt aperiam et ducimus quisquam quo autem error. Et praesentium ipsum sit adipisci quia et sunt reprehenderit.Eos harum dolorum in iure aspernatur aut consectetur dolores. In quae itaque et dolorem natus quo voluptate molestias non commodi officia est laborum molestiae est vitae aliquam. Non autem ipsa ex consequuntur quae et natus tempore! Sed debitis pariatur non optio inventore sit aspernatur mollitia ut ipsa sunt a impedit nihil eum asperiores possimus est ullam quis. 33 architecto expedita eos autem quisquam ea sapiente saepe et delectus facilis et odio excepturi ad numquam iure. Aut sunt quia in nihil architecto cum explicabo sint et galisum perspiciatis. Non possimus mollitia non Quis labore eos dignissimos galisum. Qui excepturi accusamus eum tempora quibusdam et deserunt omnis qui consequuntur pariatur sit dignissimos vero est nisi distinctio est quaerat doloremque.Aut galisum vero id rerum molestiae sed dolores nihil. Ex dolor quia ut provident modi qui voluptatem iusto vel quia explicabo ut expedita quam sed quia reprehenderit aut repellat perspiciatis. Et delectus aliquid quo aspernatur quidem sit reiciendis sint. Ut molestiae consequatur ea eaque consequatur et fugiat consequatur vel suscipit dolores ad nesciunt dolorem. Non quibusdam maiores et blanditiis laborum sed vitae nemo et distinctio sunt aut dolor repudiandae. Non praesentium rerum aut voluptas error vel eius pariatur aut reprehenderit voluptatum? Et vero nemo ad amet enim et vitae veniam in optio consequatur non autem itaque eos animi expedita. Sit quis suscipit cum ipsum enim rem omnis nobis eum debitis autem. Aut similique voluptatem non recusandae quod ad reprehenderit.";
char tx_buf[MAX_DATA_LEN] = {};



/* Callback after init operation. */
static void init(const uint64_t *time, int16_t temp, enum nrf_modem_dect_phy_err err,
				 const struct nrf_modem_dect_phy_modem_cfg *cfg)
{
	if (err)
	{
		LOG_ERR("Init failed, err %d", err);
		exit = true;
		return;
	}

	k_sem_give(&operation_sem);
}

/*
	PHY modem functions
*/

/* Callback after deinit operation. */
static void deinit(const uint64_t *time, enum nrf_modem_dect_phy_err err)
{
	if (err)
	{
		LOG_ERR("Deinit failed, err %d", err);
		return;
	}

	k_sem_give(&operation_sem);
}

/* Operation complete notification. */
static void op_complete(const uint64_t *time, int16_t temperature,
						enum nrf_modem_dect_phy_err err, uint32_t handle)
{
	LOG_DBG("op_complete cb time %" PRIu64 " status %d", *time, err);
	k_sem_give(&operation_sem);
}

/* Callback after receive stop operation. */
static void rx_stop(const uint64_t *time, enum nrf_modem_dect_phy_err err, uint32_t handle)
{
	LOG_DBG("rx_stop cb time %" PRIu64 " status %d handle %d", *time, err, handle);
	k_sem_give(&operation_sem);
}

/* Physical Control Channel reception notification. */
static void pcc(
	const uint64_t *time,
	const struct nrf_modem_dect_phy_rx_pcc_status *status,
	const union nrf_modem_dect_phy_hdr *hdr)
{
	struct phy_ctrl_field_common *header = (struct phy_ctrl_field_common *)hdr->type_1;
}

/* Physical Control Channel CRC error notification. */
static void pcc_crc_err(const uint64_t *time,
						const struct nrf_modem_dect_phy_rx_pcc_crc_failure *crc_failure)
{
	LOG_DBG("pcc_crc_err cb time %" PRIu64 "", *time);
}

/* Physical Data Channel reception notification. */
// static void pdc(const uint64_t *time,
// 				const struct nrf_modem_dect_phy_rx_pdc_status *status,
// 				const void *data_void, uint32_t len)
// {
// 	set_led(0);
// 	char* data = (char *)data_void;
// 	enum TestHeaderType header_type = (enum TestHeaderType)(data[0]);
// 	// LOG_INF("L: %d", len);
// 	// LOG_INF("Header type %d", header_type);
// 	if (is_rx)
// 	{
// 		switch (current_test_status)
// 		{
// 		case NotRunning:
// 			if (header_type != ScheduleTest)
// 				return;
// 			current_test_status = Running;
// 			respond_to_test_start_as_rx = true;

// 			break;
// 		case Scheduled:
// 		case Running:
// 			if (header_type == Testing)
// 			{
// 				num_of_tx_recieved++;
//     			// LOG_HEXDUMP_INF(data, 480U, "Sample Data!"); 
// 				// data[len-1] = 0;
// 				// if (MAX_DATA_LEN < len) {
// 				// 	data[MAX_DATA_LEN - 1] = 0;
// 				// }
// 				if (num_of_tx_recieved % 100 == 0)
// 					printk("Data recieved (len %d)\n", len);
// 				if (num_of_tx_recieved == 154)
//     				LOG_HEXDUMP_INF(data, len, "Sample Data!"); 
// 				// for(int i = 10; i < len && i < MAX_DATA_LEN; i++) {
// 				// 	if (data[i] != tx_buf[i]) {
// 				// 		LOG_ERR("Wrong data at position %d: %d %d", i, data[i], tx_buf[i]);
// 				// 	}
// 				// }
// 			}
// 			else if (header_type == EndTest)
// 			{
// 				current_test_status = NotRunning;
// 				send_statistics_back = true;
// 			}
// 		}
// 	}
// 	else
// 	{
// 		switch (current_test_status)
// 		{
// 		case NotRunning:
// 		case Scheduled:
// 			if (header_type == StartTest)
// 			{
// 				LOG_INF("Device ready to take test");
// 				devices_in_test++;
// 			}
// 		case Ended:
// 			if (header_type == TestResults)
// 			{
// 				LOG_HEXDUMP_INF(data, 50U, "Results hexdump:");
// 				int msg_recieved_inner;
// 				LOG_INF("WAAAAAAY");

// 				memcpy(&msg_recieved_inner, data+1, sizeof(msg_recieved_inner));
// 				LOG_INF("WAAAAAAY");
// 				// LOG_HEXDUMP_INF(msg_recieved_inner, sizeof(msg_recieved_inner), "msg_recieved_inner content:");
// 				LOG_INF("Messages recieved: %d", msg_recieved_inner);
// 			}
// 		}
// 	}
// 	return;
// 	// // if msg is statistics (starts with M)
// 	// if (((char *)data)[0] == 'M')
// 	// {
// 	// 	if (is_rx)
// 	// 		return;
// 	// 	LOG_INF("%s", (char *)data);
// 	// 	// turn of the led if you are sending, if you are reading the led should still be on
// 	// 	gpio_pin_set_dt(&led, is_rx);
// 	// 	// can_send_tx = true;
// 	// 	return;
// 	// }
// 	// if (is_rx)
// 	// {
// 	// 	num_of_tx_recieved++;
// 	// 	// k_timer_start(&last_msg_timer, K_MSEC(500), K_NO_WAIT);
// 	// }
// 	// // LOG_INF("Received data (RSSI: %d.%d): %d %s",
// 	// // 		(status->rssi_2 / 2), (status->rssi_2 & 0b1) * 5, num_of_tx_recieved, (char *)data);
// 	// // uint8_t *state = (uint8_t *)data;
// 	// // if (len > 0 && (*state == '0' || *state == '1'))
// 	// // {
// 	// // 	gpio_pin_set_dt(&led, *state - '0');
// 	// // }
// }

/* Physical Data Channel CRC error notification. */
static void pdc_crc_err(
	const uint64_t *time, const struct nrf_modem_dect_phy_rx_pdc_crc_failure *crc_failure)
{
	LOG_DBG("pdc_crc_err cb time %" PRIu64 "", *time);
}

/* RSSI measurement result notification. */
static void rssi(const uint64_t *time, const struct nrf_modem_dect_phy_rssi_meas *status)
{
	LOG_DBG("rssi cb time %" PRIu64 " carrier %d", *time, status->carrier);
}

/* Callback after link configuration operation. */
static void link_config(const uint64_t *time, enum nrf_modem_dect_phy_err err)
{
	LOG_DBG("link_config cb time %" PRIu64 " status %d", *time, err);
}

/* Callback after time query operation. */
static void time_get(const uint64_t *time, enum nrf_modem_dect_phy_err err)
{
	LOG_DBG("time_get cb time %" PRIu64 " status %d", *time, err);
}

/* Callback after capability get operation. */
static void capability_get(const uint64_t *time, enum nrf_modem_dect_phy_err err,
						   const struct nrf_modem_dect_phy_capability *capability)
{
	LOG_DBG("capability_get cb time %" PRIu64 " status %d", *time, err);
}

/* Dect PHY callbacks. */
static struct nrf_modem_dect_phy_callbacks dect_phy_callbacks = {
	.init = init,
	.deinit = deinit,
	.op_complete = op_complete,
	.rx_stop = rx_stop,
	.pcc = pcc,
	.pcc_crc_err = pcc_crc_err,
	.pdc = handle_rx_pdc,
	.pdc_crc_err = pdc_crc_err,
	.rssi = rssi,
	.link_config = link_config,
	.time_get = time_get,
	.capability_get = capability_get,
};

/* Dect PHY init parameters. */
static struct nrf_modem_dect_phy_init_params dect_phy_init_params = {
	.harq_rx_expiry_time_us = 5000000,
	.harq_rx_process_count = 4,
};

/* Timers*/
// wait a fraction of a second at start to see if the button is pressed
// at the end of this the device is set into rx or tx mode
extern void set_rx_or_tx(struct k_timer *timer_id)
{
	// if the device is in TX mode, 
	if (globals.has_sent) {
		dect_phy_callbacks.pdc = handle_tx_pdc;
	}
	globals.is_rx = !globals.has_sent;
}

K_TIMER_DEFINE(rxtx_timer, set_rx_or_tx, NULL);



int main(void)
{
	int err;

	LOG_INF("Dect NR+ PHY Hello sample started");

	if (init_led_and_button() >= 0) return 0;
	if (modem_init(&dect_phy_callbacks, &dect_phy_init_params, globals.device_id, &operation_sem) >= 0) return 0;
	// if (uart_setup() >= 0) return 0;
	uart_setup();

	globals.rx.missed_msg = list_create();

	LOG_INF("Initialization complete");

	// if the button is pressed in 1 second, the device will go into tx mode
	k_timer_start(&rxtx_timer, K_MSEC(1000), K_NO_WAIT);
	// memset(tx_buf, ':', MAX_DATA_LEN*sizeof(tx_buf[0]));
	// tx_buf[MAX_DATA_LEN-1] = '0';

	int button_state;
	int prev_button_state = 0;
	while (1) {
		while (!globals.is_rx)
		{
		set_led(0);

			switch (globals.cur_test_status) {
				case NotRunning:
					// you can schedule 10 same tests, to run in a row
					if (globals.test_settings.times > 0) {
						globals.cur_test_status = Scheduled;
						globals.test_settings.times--;
					}

					// schedule the test with some default parameters when button1 is pressed
					button_state = read_button();
					if (prev_button_state != button_state) {
						prev_button_state = button_state;
						if (button_state != 1)
						{
							continue;
						}
						globals.cur_test_status = Scheduled;
						globals.test_settings = (TestSettings) {
							.mcs = 4,
							.msg_to_send = 2000,
							.times = 1,
						};
					}
					break;

				case Scheduled:
					globals.has_sent = true;

					// change pdc (data) callback, because the device will be in tx mode
					dect_phy_callbacks.pdc = handle_tx_pdc;
					err = nrf_modem_dect_phy_callback_set(&dect_phy_callbacks);
					if (err)
					{
						LOG_ERR("nrf_modem_dect_phy_init failed, err %d", err);
						return err;
					}

					LOG_INF("Starting TX test");
					err = start_test_tx(&globals.test_settings, tx_buf);
					if (err != 0) {
						LOG_ERR("start_test_tx err %d", err);
					}
					globals.cur_test_status = NotRunning;
			}
		}


		set_led(1);
		LOG_INF("Recieving msg!");
		while (globals.is_rx)
		{
			if (globals.rx.respond_to_test_start_as_rx)
			{
				globals.rx.respond_to_test_start_as_rx = false;
				start_rx_test(tx_buf);
			}
			else if (globals.rx.send_statistics_back)
			{
				globals.rx.send_statistics_back = false;
				end_rx_test(tx_buf);
			}

			err = receive(RX_HANDLE, 2000);
			if (err != 0)
			{
				LOG_ERR("Error during receiving %d", err);
				continue;
			}
			/* Wait for RX operation to complete. */
			k_sem_take(&operation_sem, K_FOREVER);
		}
	}

	LOG_INF("Shutting down");
	modem_deinit(&operation_sem);

	LOG_INF("Bye!");

	return 0;
}
```

## src/common.c
```c
#include "common.h"
#include <stdlib.h>

K_SEM_DEFINE(operation_sem, 0, 1);
Globals globals = {};

LOG_MODULE_REGISTER(common, LOG_LEVEL_DBG);

K_HEAP_DEFINE(list_heap, 1024 * 8);
List list_create() {
	return (List) {
		.capacity = 8,
		.size = 0,
		.data = (int*) k_heap_alloc(&list_heap, sizeof(int) * 8, K_NO_WAIT),
	};
}

void expand_list(List *lst) {
	int new_capacity = lst->capacity * 2;
	int* ptr = (int*) k_heap_alloc(&list_heap, sizeof(int) * new_capacity, K_NO_WAIT);
	if (ptr == NULL) return -1;
	// LOG_INF("set up ptr old:%d, new: %d", lst->capacity, new_capacity);

	for (int i = 0; i < lst->size; i++) {
		ptr[i] = lst->data[i];
	}

	k_heap_free(&list_heap, lst->data);
	lst->capacity = new_capacity;
	lst->data = ptr;
}

int list_append(List *lst, int data) {
	if (lst->size == lst->capacity) {
		LOG_INF("helou %d", data);
		expand_list(lst);
	}

	lst->data[lst->size] = data;
	lst->size++;
	if (lst->size < 15)
		LOG_DBG("size: %d, cap: %d, num: %d", lst->size, lst->capacity, data);
	return 0;
}

int list_to_bin(List l, char* buf, int buf_len) {
	if (l.size * sizeof(l.data[0]) + 1 > buf_len)
		return -1;
	buf[0] = (char) l.size;
	memcpy(buf + 1, l.data, l.size * sizeof(l.data[0]));
	LOG_HEXDUMP_INF(buf, 20, "Bin list");
	return 0;
}

int list_from_bin(List *l, char* buf, int buf_len) {
	list_clear(l);
	int size = buf[0];
	if (buf_len - 1 < size * sizeof(l->data[0]))
		return -1;
	while (size < l->size) {
		expand_list(l);
	}

	memcpy(l->data, buf + 1, size * sizeof(l->data[0]));
	return 0;
}

int list_to_string(List l, char* buf, int buf_len) {
	if (buf_len < 3)
		return -1;
	
	int buf_progress = 1;
	buf[0] = '[';

	for (int i = 0; i < l.size; i++) {
		if (buf_progress >= buf_len - 1)
			return -2;
		buf_progress += sprintf(buf + buf_progress, i != 0 ? ", %d" : "%d", list_get(&l, i));
	}
	buf[buf_progress] = ']';
	buf[buf_progress + 1] = '\0';
	return 0;
}

int list_get(List *lst, int ix) {
	if (0 <= ix && ix <= lst->size) {
		return lst->data[ix];
	}
	return INT_MIN;
}

void list_clear(List *lst) {
	lst->size = 0;
}



/* Send operation. */
int transmit(uint32_t handle, void *data, size_t data_len, int mcs)
{
	int err;
	// LOG_INF("data len: %d", data_len);

	struct phy_ctrl_field_common header = {
		.header_format = 0x0,
		.packet_length_type = 0x0,
		.packet_length = SUBSLOTS_USED,
		.short_network_id = (CONFIG_NETWORK_ID & 0xff),
		.transmitter_id_hi = (globals.device_id >> 8),
		.transmitter_id_lo = (globals.device_id & 0xff),
		.transmit_power = CONFIG_TX_POWER,
		.reserved = 0,
		.df_mcs = mcs,
	};

	struct nrf_modem_dect_phy_tx_params tx_op_params = {
		.start_time = 0,
		.handle = handle,
		.network_id = CONFIG_NETWORK_ID,
		.phy_type = 0,
		.lbt_rssi_threshold_max = 0,
		.carrier = CONFIG_CARRIER,
		.lbt_period = NRF_MODEM_DECT_LBT_PERIOD_MAX,
		.phy_header = (union nrf_modem_dect_phy_hdr *)&header,
		.data = data,
		// .data_size = mcs_subslots_size[mcs][SUBSLOTS_USED],
		.data_size = data_len,
	};
	err = nrf_modem_dect_phy_tx(&tx_op_params);
	if (err != 0)
	{
		return err;
	}

	return 0;
}

/* Receive operation. */
int receive(uint32_t handle, uint32_t duration_ms)
{
	int err;

	struct nrf_modem_dect_phy_rx_params rx_op_params = {
		.start_time = 0,
		.handle = handle,
		.network_id = CONFIG_NETWORK_ID,
		.mode = NRF_MODEM_DECT_PHY_RX_MODE_CONTINUOUS,
		.rssi_interval = NRF_MODEM_DECT_PHY_RSSI_INTERVAL_OFF,
		.link_id = NRF_MODEM_DECT_PHY_LINK_UNSPECIFIED,
		.rssi_level = -60,
		.carrier = CONFIG_CARRIER,
		.duration = duration_ms *
					NRF_MODEM_DECT_MODEM_TIME_TICK_RATE_KHZ,
		.filter.short_network_id = CONFIG_NETWORK_ID & 0xff,
		.filter.is_short_network_id_used = 1,
		/* listen for everything (broadcast mode used) */
		.filter.receiver_identity = 0,
	};
	err = nrf_modem_dect_phy_rx(&rx_op_params);
	if (err != 0)
	{
		return err;
	}

	return 0;
}


const int mcs_subslots_size[MAX_MCS + 1][MAX_NUM_OF_SUBSLOTS + 1] = {
	{0,
	 136,
	 264,
	 400,
	 536,
	 664,
	 792,
	 920},
	{32,
	 296,
	 552,
	 824,
	 1096,
	 1352,
	 1608,
	 1864},
	{56,
	 456,
	 856,
	 1256,
	 1640,
	 2024,
	 2360,
	 2774},
	{88,
	 616,
	 1128,
	 1672,
	 2168,
	 2680,
	 3192,
	 3704},
	{144,
	 936,
	 1736,
	 2488,
	 3256,
	 4024,
	 4832,
	 5600}};
```

## src/common.h
```c
#ifndef _COMMON_H
#define _COMMON_H

#define TX_HANDLE 0
#define RX_HANDLE 1
#define MAX_MCS 4
#define MAX_NUM_OF_SUBSLOTS 7
// #define MAX_DATA_LEN 15
#define MAX_DATA_LEN 700
#define SUBSLOTS_USED MAX_NUM_OF_SUBSLOTS

#include <inttypes.h>
// #include <stdbool.h>
#include <zephyr/kernel.h>
#include <zephyr/device.h>
#include <zephyr/drivers/hwinfo.h>
#include <zephyr/drivers/gpio.h>
#include <zephyr/sys/util.h>
#include <zephyr/sys/printk.h>
#include <zephyr/logging/log.h>

#include <nrf_modem_dect_phy.h>
#include <modem/nrf_modem_lib.h>

// this semaphere is used all throught the program
// it ensures that the modem system call are syncronised
extern struct k_sem operation_sem;


typedef struct {
	uint16_t num_sent;
	uint8_t end_responses_recieved;
	uint8_t devices_in_test;
} TransmitGlobals;

typedef struct List {
	int *data;
	int capacity;
	int size;
} List;

typedef struct {
	uint16_t num_recv;
	bool respond_to_test_start_as_rx;
	bool send_statistics_back;
	uint16_t last_msg_number;
	List missed_msg;
} RecieveGlobals;


typedef struct {
    int times;
    int mcs;
	int msg_to_send;
} TestSettings;

enum TestStatus
{
	NotRunning,
	Scheduled,
	Running,
	Ended,
};

/* Header type 1, due to endianness the order is different than in the specification. */
struct phy_ctrl_field_common
{
	uint32_t packet_length : 4;
	uint32_t packet_length_type : 1;
	uint32_t header_format : 3;
	uint32_t short_network_id : 8;
	uint32_t transmitter_id_hi : 8;
	uint32_t transmitter_id_lo : 8;
	uint32_t df_mcs : 3;
	uint32_t reserved : 1;
	uint32_t transmit_power : 4;
	uint32_t pad : 24;
};

enum TestHeaderType
{
	// send by tx node to start test
	ScheduleTest,
	// rx answers to ScheduleTest so tx knows how many participants
	StartTest,
	Testing,
	// tx sends to signal end of test
	EndTest,
	// rx responds with results
	TestResults,
};

typedef struct {
	enum TestHeaderType type;
	char mcs; // 1B velik prostor
	int msg_num;
} TestHeader;


typedef struct {
	RecieveGlobals rx;
	TransmitGlobals tx;
	uint16_t device_id;
	enum TestStatus cur_test_status;
	TestSettings test_settings;
	bool is_rx;
	bool has_sent;
} Globals;
extern Globals globals;


int transmit(uint32_t handle, void *data, size_t data_len, int mcs);
int receive(uint32_t handle, uint32_t duration_ms);

List list_create();
int list_append(List *lst, int data);
int list_get(List *lst, int ix);
int list_to_string(List l, char* buf, int buf_len);
int list_to_bin(List l, char* buf, int buf_len);
int list_from_bin(List *l, char* buf, int buf_len);
void list_clear(List *lst);


extern const int mcs_subslots_size[MAX_MCS + 1][MAX_NUM_OF_SUBSLOTS + 1];


#endif
```

## src/init.c
```c
#include "init.h"
#include "common.h"


LOG_MODULE_REGISTER(init, LOG_LEVEL_DBG);


/* Button and led initialization */
#define SW0_NODE DT_ALIAS(sw0)
#if !DT_NODE_HAS_STATUS(SW0_NODE, okay)
#error "Unsupported board: sw0 devicetree alias is not defined"
#endif
static const struct gpio_dt_spec button = GPIO_DT_SPEC_GET_OR(SW0_NODE, gpios,
															  {0});
static struct gpio_dt_spec led = GPIO_DT_SPEC_GET_OR(DT_ALIAS(led0), gpios,
													 {0});

int init_led_and_button() {
	int err;
	/* Button and led setup*/
	if (!gpio_is_ready_dt(&button))
	{
		printk("Error: button device is not ready\n");
		return 0;
	}

	err = gpio_pin_configure_dt(&button, GPIO_INPUT);
	if (err != 0)
	{
		printk("Error %d: failed to configure %s pin %d\n",
			   err, button.port->name, button.pin);
		return 0;
	}
	if (led.port && !gpio_is_ready_dt(&led))
	{
		printk("Error %d: LED device %s is not ready; ignoring it\n",
			   err, led.port->name);
		led.port = NULL;
	}
	if (led.port)
	{
		err = gpio_pin_configure_dt(&led, GPIO_OUTPUT);
		if (err != 0)
		{
			printk("Error %d: failed to configure LED device %s pin %d\n",
				   err, led.port->name, led.pin);
			led.port = NULL;
		}
		else
		{
			printk("Set up LED at %s pin %d\n", led.port->name, led.pin);
		}
	}
    return -1;
}

int modem_init(struct nrf_modem_dect_phy_callbacks *dect_phy_callbacks, struct nrf_modem_dect_phy_init_params *dect_phy_init_params, long device_id, struct k_sem *operation_sem) {
	int err;

	err = nrf_modem_lib_init();
	if (err)
	{
		LOG_ERR("modem init failed, err %d", err);
		return err;
	}
	
	err = nrf_modem_dect_phy_callback_set(dect_phy_callbacks);
	if (err)
	{
		LOG_ERR("nrf_modem_dect_phy_callback_set failed, err %d", err);
		return err;
	}
	
	err = nrf_modem_dect_phy_init(dect_phy_init_params);
	if (err)
	{
		LOG_ERR("nrf_modem_dect_phy_init failed, err %d", err);
		return err;
	}


	k_sem_take(operation_sem, K_FOREVER);
	// if (exit)
	// {
	// 	return -EIO;
	// }
	hwinfo_get_device_id((void *)&device_id, sizeof(device_id));

	LOG_INF("Dect NR+ PHY initialized, device ID: %d", device_id);

	err = nrf_modem_dect_phy_capability_get();
	if (err)
	{
		LOG_ERR("nrf_modem_dect_phy_capability_get failed, err %d", err);
	}

    return -1;

}

int modem_deinit(struct k_sem *operation_sem){
    int err;
	err = nrf_modem_dect_phy_deinit();
	if (err)
	{
		LOG_ERR("nrf_modem_dect_phy_deinit() failed, err %d", err);
		return err;
	}

	k_sem_take(operation_sem, K_FOREVER);

	err = nrf_modem_lib_shutdown();
	if (err)
	{
		LOG_ERR("nrf_modem_lib_shutdown() failed, err %d", err);
		return err;
	}
}


void set_led(int state) {
	gpio_pin_set_dt(&led, state);
}

int read_button() {
    return gpio_pin_get_dt(&button);
}
```

## src/init.h
```c
#ifndef _INIT_H
#define _INIT_H

#include <nrf_modem_dect_phy.h>
#include <modem/nrf_modem_lib.h>

#include <zephyr/kernel.h>
#include <zephyr/device.h>
#include <zephyr/drivers/hwinfo.h>
#include <zephyr/drivers/gpio.h>
#include <zephyr/sys/util.h>
#include <zephyr/logging/log.h>

int init_led_and_button();
int modem_init(struct nrf_modem_dect_phy_callbacks *dect_phy_callbacks,
               struct nrf_modem_dect_phy_init_params *dect_phy_init_params,
               long device_id,
               struct k_sem *operation_sem
            );
int modem_deinit();

void set_led(int state);
int read_button();

#endif
```

## src/main.h
```c
#include <string.h>
#include <inttypes.h>

#include <zephyr/kernel.h>
#include <zephyr/device.h>
#include <zephyr/drivers/hwinfo.h>
#include <zephyr/drivers/gpio.h>
#include <zephyr/sys/util.h>
#include <zephyr/sys/printk.h>
#include <zephyr/logging/log.h>
```

## src/recieve.c
```c
#include "recieve.h"

LOG_MODULE_REGISTER(recieve, LOG_LEVEL_INF);


void handle_rx_pdc(const uint64_t *time, const struct nrf_modem_dect_phy_rx_pdc_status *status, const void *data_void, uint32_t len) {
    // LOG_INF("handle_rx_pdc");

	char* data = (char *)data_void;

	set_led((globals.rx.last_msg_number % 50) < 40);

	// int64_t current_time = k_uptime_get();
	TestHeader h = {};
	memcpy(&h, data_void, sizeof(h));
	// LOG_INF("msg num: %d", h.msg_num);

    switch (globals.cur_test_status)
	{
	case NotRunning:
		if (h.type != ScheduleTest)
			return;
		globals.cur_test_status = Running;
		globals.rx.respond_to_test_start_as_rx = true;

		break;
	case Scheduled:
	case Running:
		if (h.type == Testing)
		{
			if (globals.rx.last_msg_number == 0) {
				LOG_INF("Single msg size %d B", len);
			}
			while (globals.rx.last_msg_number++ < h.msg_num) {
				LOG_ERR("Missed package %d", globals.rx.last_msg_number-1);
				list_append(&(globals.rx.missed_msg), globals.rx.last_msg_number-1);
				LOG_INF("after append");
			}
			globals.rx.num_recv++;
		}
		else if (h.type == EndTest)
		{
			globals.cur_test_status = NotRunning;
			globals.rx.send_statistics_back = true;
		}
		break;
	case Ended: break;
	}

	// int64_t end_time = k_uptime_get();
	// LOG_INF("Time needed %d in ms", end_time - current_time);
}

void start_rx_test(char tx_buf[]){
	LOG_INF("Participating in test");
	TestHeader h = {
		.mcs = 0,
		.msg_num = 0,
		.type = StartTest,
	};

	// stop 10s long rx, so it can send back participation data
	// nrf_modem_dect_phy_rx_stop(RX_HANDLE);

	LOG_DBG("type %d", h.type);
	LOG_DBG("mcs %d", h.mcs);
	LOG_DBG("msg_num %d", h.msg_num);

	memcpy(tx_buf, &h, sizeof(h));

	LOG_HEXDUMP_DBG(tx_buf, sizeof(h) * 2, "Header: ");
	TestHeader h1 = {};
	memcpy(&h1, tx_buf, sizeof(h1));

	LOG_DBG("type %d", h1.type);
	LOG_DBG("mcs %d", h1.mcs);
	LOG_DBG("msg_num %d", h1.msg_num);

	transmit(TX_HANDLE, &tx_buf, 100, 2);
	/* Wait for TX operation to complete. */
	k_sem_take(&operation_sem, K_FOREVER);
}

void end_rx_test(char tx_buf[]){
	// struct StatisticsResults {
	// 	int num_of_tx_recieved;
	// 	uint16_t device_id;
	// };
	// tx_buf[0] = TestResults;
	// struct StatisticsResults res = {
	// 	.num_of_tx_recieved = globals.rx.num_recv,
	// 	.device_id = globals.device_id,
	// };

	// // tx_buf[1] = num_of_tx_recieved;
	// // tx_buf[2] = device_id >> 8;
	// // tx_buf[3] = device_id & 0xff;
	// memcpy(tx_buf+1, &res, sizeof(res));
	LOG_DBG("msg rec: %d", globals.rx.num_recv);

	set_led(1);

	TestHeader h = {
		.type = TestResults,
		.mcs = 0,
		.msg_num = globals.rx.num_recv,
	};

	// stop 10s long rx, so it can send back statistics data
	// nrf_modem_dect_phy_rx_stop(RX_HANDLE);

	memcpy(tx_buf, &h, sizeof(h));
	int err = list_to_string(globals.rx.missed_msg, tx_buf + sizeof(h), MAX_DATA_LEN - sizeof(h));
	if (err != 0) LOG_ERR("Err %d", err);
	LOG_INF("Sending statistics");
	transmit(TX_HANDLE, (void *)tx_buf, 100, 2);

	globals.rx.num_recv = 0;
	globals.rx.last_msg_number = 0;
	list_clear(&globals.rx.missed_msg);

	/* Wait for TX operation to complete. */
	k_sem_take(&operation_sem, K_FOREVER);
}
```

## src/recieve.h
```c
#ifndef _RECIEVE_H
#define _RECIEVE_H

#include "common.h"
#include "init.h"
// #include <nrf_modem/include/nrf_modem_dect_phy.h>

void handle_rx_pdc(const uint64_t *time,
				const struct nrf_modem_dect_phy_rx_pdc_status *status,
				const void *data_void, uint32_t len);
void start_rx_test();
void end_rx_test(char tx_buf[]);

#endif // _RECIEVE_H
```

## src/serial_communication.c
```c
#include "serial_communication.h"

LOG_MODULE_REGISTER(uart, LOG_LEVEL_DBG);

char uart_buffer[UART_BUF_LEN] = {};
void uart_callback(const struct device *dev, struct uart_event *evt, void *user_data);
bool proccess_msg(const struct device *dev, struct uart_event *evt, char data[]);


int uart_setup() {
    int err;

    // get uart device
    struct device* uart0 = DEVICE_DT_GET(DT_CHOSEN(zephyr_shell_uart));
    if (!device_is_ready(uart0)) {
        LOG_ERR("Uart0 device is not ready.");
        return 0;
    }

    // use uart_callback funcion without any specific data, to be send to it, as there are globals already
    err = uart_callback_set(uart0, uart_callback, NULL);
    if (err < 0) {
        LOG_ERR("Error with 'uart_callback_set': %d", err);
        return err;
    }
    err = uart_rx_enable(uart0, uart_buffer, UART_BUF_LEN, UART_RX_TIMEOUT);
    if (err < 0) {
        LOG_ERR("Error with 'uart_rx_enable': %d", err);
        return err;
    }
    LOG_DBG("Setup uart");

    return 0;
}

// callback for uart communication
void uart_callback(const struct device *dev, struct uart_event *evt, void *user_data) {
    LOG_DBG("Data from uart! ");
    int err;

    switch (evt->type) {
        case UART_RX_RDY:
            LOG_DBG("UART_RX_RDY");
            proccess_msg(dev, evt, evt->data.rx.buf + evt->data.rx.offset);
            break;

        case UART_RX_BUF_REQUEST:
            for (int i = 0; i < UART_BUF_LEN; i++)
                uart_buffer[i] = 0;
            err = uart_rx_buf_rsp(dev, uart_buffer, UART_BUF_LEN);
            if (err < 0) {
                LOG_ERR("uart_rx_buf_rsp %d", err);
                return;
            }
            break;

        case UART_RX_BUF_RELEASED:
        case UART_RX_DISABLED:
        case UART_RX_STOPPED:
        case UART_TX_DONE:
        case UART_TX_ABORTED:
            LOG_DBG("other uart code %d", evt->type);
            break;
        default:
            LOG_ERR("Wrong UART_CODE");
            break;
    }
    return;
}
bool starts_with(char *data, char *template) {
    int i = 0;
    while (template[i] != '\0' && data[i] != '\0') {
        if (data[i] != template[i]) {
            return false;
        }
        i++;
    }
    return true;
}

bool proccess_msg(const struct device *dev, struct uart_event *evt, char data[]) {
    LOG_INF("|%s|", data);
    // LOG_DBG("same %d", cmp(data, "ping\r\n"));
    // LOG_DBG("same %d", data[cmp(data, "ping\r\n")]);
    // for (int i = 0; i < 6; i++) {
    //     if (data[i] == 0) break;
    //     LOG_DBG("Compare data: %c, ping: %c", data[i], "ping\r\n"[i]);
    // }
    if (starts_with(data, "ping")) {
        uart_tx(dev, "pong\r\n", 7, 100);
    } else if (starts_with(data, "start")) {
        // get the test parameters and "schedule" it
        globals.is_rx = false;
        TestSettings set = {};

        sscanf(data, "start mcs:%d times:%d msg:%d",  &set.mcs, &set.times, &set.msg_to_send);
        globals.test_settings = set;
    } else if (starts_with(data, "stop")) {
        globals.cur_test_status = Ended;
    } else if (starts_with(data, "restart")) {
        sys_reboot(SYS_REBOOT_COLD);
    } else return false;
    return true;
}
```

## src/serial_communication.h
```c
#ifndef _SERIAL_COMMUNICATION_H
#define _SERIAL_COMMUNICATION_H

#include "common.h"
#include "init.h"

#include <string.h>
#include <zephyr/drivers/uart.h>
#include <zephyr/sys/reboot.h>
#include <zephyr/toolchain.h>

#define UART_BUF_LEN 1024
#define UART_RX_TIMEOUT 1000

int uart_setup();

#endif // _SERIAL_COMMUNICATION_H
```

## src/transmit.c
```c
#include <inttypes.h>
#include "transmit.h"
#include "common.h"
#include "common.h"

LOG_MODULE_REGISTER(transmit, LOG_LEVEL_INF);

// extern k_sem operation_sem;

int setup_tx_test(TestSettings* settings, char tx_buf[]);
void finish_tx_test(TestSettings* settings, char tx_buf[]);

int start_test_tx(TestSettings* settings, char tx_buf[])
{
	int err;
	if (settings->mcs > MAX_MCS)
	{
		LOG_ERR("MCS value set too high, dont have data for it");
		return -1;
	}
	// int max_data_len = mcs_subslots_size[mcs][SUBSLOTS_USED];
	int max_data_len = mcs_subslots_size[settings->mcs][SUBSLOTS_USED] / 8;

	tx_buf[0] = ScheduleTest;
	tx_buf[1] = settings->mcs;

	/* Signal to start test */
	err = setup_tx_test(settings, tx_buf);
	if (err < 0) return err;

	globals.cur_test_status = Running;
	tx_buf[0] = Testing;
	int msg_send = 0;
	
	// int64_t current_time = k_uptime_get();
	LOG_INF("max data len %d", max_data_len);
	// while (globals.cur_test_status == Running && k_uptime_get() - current_time <= settings->seconds * MSEC_PER_SEC)
	// while (current_test_status == Running && msg_send < 1500)
	TestHeader h = {
		.type = Running,
		.mcs = settings->mcs,
		.msg_num = 0,
	};

	int64_t start_time = k_uptime_get();
	for (int i = 0; i < settings->msg_to_send; i++)
	{
		h.msg_num = i;
		memcpy(tx_buf, &h, sizeof(h));

		// err = transmit(TX_HANDLE, (void *)tx_buf, max_data_len, settings->mcs);
		err = transmit(TX_HANDLE, (void *)tx_buf, 100, settings->mcs);

		if (err != 0)
		{
			LOG_ERR("Error during transmition %d", err);
			continue;
		}
		if (msg_send % 100 == 0)
			LOG_DBG("Sent test %d", msg_send);

		msg_send++;
		set_led(msg_send % 50 > 25 ? 1 : 0);

		/* Wait for TX operation to complete. */
		k_sem_take(&operation_sem, K_FOREVER);

		// k_msleep(5);
	}
	int64_t end_time = k_uptime_get();
	LOG_INF("Time needed: %d ms", end_time - start_time);
	set_led(0);

	LOG_INF("msg sent: %d", msg_send);
	LOG_INF("msg size: %dB = %db", max_data_len, max_data_len * 8);
	LOG_INF("Data sent: %d b", max_data_len * 8 * msg_send);
	
	finish_tx_test(settings, tx_buf);
	return 0;
}

int setup_tx_test(TestSettings* settings, char tx_buf[]) {
	int err;
	globals.tx.devices_in_test = 0;
	globals.cur_test_status = Scheduled;
	for (int i = 0; i < 10; i++)
	{
		tx_buf[2] = i;
		err = transmit(TX_HANDLE, (void *)tx_buf, 100, settings->mcs);
		// err = transmit(TX_HANDLE, (void *)tx_buf, mcs_subslots_size[0][1], 0);
		if (err != 0)
		{
			LOG_ERR("Error during transmition %d", err);
			return -1;
		}
		/* Wait for TX operation to complete. */
		k_sem_take(&operation_sem, K_FOREVER);
		// LOG_INF("Send invitation");
		err = receive(RX_HANDLE, 250);
		if (err != 0)
		{
			LOG_ERR("Error during recieving %d", err);
			return -1;
		}
		/* Wait for TX operation to complete. */
		k_sem_take(&operation_sem, K_FOREVER);
	}
	if (globals.tx.devices_in_test == 0)
	{
		LOG_ERR("No devices to take tests with");
		return -2;
	}

	return 0;
}

void finish_tx_test(TestSettings* settings, char tx_buf[]) {
	int err;
	globals.tx.end_responses_recieved = 0;
	tx_buf[0] = EndTest;
	globals.cur_test_status = Ended;
	LOG_INF("listening for resp");
	for (int i = 0; i < 10; i++)
	{
		if (globals.tx.end_responses_recieved >= globals.tx.devices_in_test)
			break;
		err = transmit(TX_HANDLE, (void *)tx_buf, 10, 0);
		if (err != 0)
		{
			LOG_ERR("Error during transmition %d", err);
			continue;
		}
		/* Wait for TX operation to complete. */
		k_sem_take(&operation_sem, K_FOREVER);
		err = receive(RX_HANDLE, 250);
		if (err != 0)
		{
			LOG_ERR("Error during transmition %d", err);
			continue;
		}
		/* Wait for RX operation to complete. */
		k_sem_take(&operation_sem, K_FOREVER);
	}
	LOG_INF("end responses");
	k_msleep(100);
	globals.cur_test_status = NotRunning;

}

void handle_tx_pdc(const uint64_t *time, const struct nrf_modem_dect_phy_rx_pdc_status *status, const void *data_void, uint32_t len) {
	LOG_DBG("handle_tx_pdc");

	TestHeader h = {};
	LOG_HEXDUMP_DBG(data_void, sizeof(h) * 10, "Header: ");
	memcpy(&h, data_void, sizeof(h)); // idk why +4, but it works // update, works only for StartTest, not for TestResults ;(((((
	LOG_INF("type %d", h.type);
	LOG_INF("mcs %d", h.mcs);
	LOG_INF("msg_num %d", h.msg_num);

	switch (globals.cur_test_status)
	{
	case NotRunning:
	case Scheduled:
		LOG_INF("Device ready to take test");
		globals.tx.devices_in_test++;
		break;

	case Ended:
		LOG_INF("Messages recieved: %d", h.msg_num);
		// List l = list_create();
		// char str[256] = {};
		// LOG_INF("1");
		// list_from_bin(&l, (char *)data_void + sizeof(h), len);
		// LOG_INF("2");
		// list_to_string(l, str, 256);
		// LOG_INF("Missed msg: %s", str);
		LOG_INF("Missed msg: %s", (char *)data_void + sizeof(h));
		break;
	}
}
```

## src/transmit.h
```c
#ifndef _TRANSMIT_H
#define _TRANSMIT_H

#include <string.h>
#include <inttypes.h>

#include <string.h>
#include <inttypes.h>
#include <nrf_modem_dect_phy.h>
#include <modem/nrf_modem_lib.h>

#include <zephyr/kernel.h>
#include <zephyr/device.h>
#include <zephyr/drivers/hwinfo.h>
#include <zephyr/drivers/gpio.h>
#include <zephyr/sys/util.h>
#include <zephyr/sys/printk.h>
#include <zephyr/logging/log.h>


#include <inttypes.h>
#include "common.h"


int start_test_tx(TestSettings* settings, char tx_buf[]);
void handle_tx_pdc(const uint64_t *time, const struct nrf_modem_dect_phy_rx_pdc_status *status, const void *data_void, uint32_t len);

#endif
```
